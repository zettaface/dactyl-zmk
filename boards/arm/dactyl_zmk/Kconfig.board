## boards/shields/ptero_dactyl/Kconfig.defconfig
```kconfig
if SHIELD_PTERO_DACTYL_LEFT

config ZMK_KEYBOARD_NAME
    default "ptero-dactyl"

config ZMK_SPLIT_ROLE_CENTRAL
    default y

endif # SHIELD_PTERO_DACTYL_LEFT

if SHIELD_PTERO_DACTYL_LEFT || SHIELD_PTERO_DACTYL_RIGHT

config ZMK_SPLIT
    default y

endif # SHIELD_PTERO_DACTYL_LEFT || SHIELD_PTERO_DACTYL_RIGHT

if SHIELD_PTERO_DACTYL_RIGHT

config SPI
    default y

endif
```

## boards/shields/ptero_dactyl/Kconfig.shield
```kconfig
config SHIELD_PTERO_DACTYL_LEFT
    def_bool $(shields_list_contains,ptero_dactyl_left)

config SHIELD_PTERO_DACTYL_RIGHT
    def_bool $(shields_list_contains,ptero_dactyl_right)
```

## config/west.yml
```yaml
manifest:
  remotes:
    - name: zmkfirmware
      url-base: https://github.com/zmkfirmware
    - name: badjeff
      url-base: https://github.com/badjeff
    - name: jewtvet
      url-base: https://github.com/jewtvet
    - name: zettaface
      url-base: https://github.com/zettaface
    - name: hsgw
      url-base: https://github.com/hsgw
    - name: efogdev
      url-base: https://github.com/efogdev
    # Additional modules containing boards/shields/custom code can be listed here as well
    # See https://docs.zephyrproject.org/3.2.0/develop/west/manifest.html#projects
  projects:
    - name: zmk
      remote: zmkfirmware
      revision: main
      import: app/west.yml
    # - name: zmk-pmw3610-driver
    #   remote: efogdev
    #   revision: zephyr-4.1
    - name: zmk-ruen
      remote: jewtvet
      revision: main
    - name: zmk-input-processor-keybind
      remote: zettaface
      revision: main
    - name: zmk-input-processor-report-rate-limit
      remote: badjeff
      revision: main
    - name: zmk-feature-sensor_rotation
      remote: hsgw
      revision: main
    - name: zmk-axis-clamper
      remote: zettaface
      revision: main
  self:
    path: config
```
